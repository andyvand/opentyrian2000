/*
  Simple DirectMedia Layer
  Copyright (C) 1997-2025 Sam Lantinga <slouken@libsdl.org>

  This software is provided 'as-is', without any express or implied
  warranty.  In no event will the authors be held liable for any damages
  arising from the use of this software.

  Permission is granted to anyone to use this software for any purpose,
  including commercial applications, and to alter it and redistribute it
  freely, subject to the following restrictions:

  1. The origin of this software must not be misrepresented; you must not
     claim that you wrote the original software. If you use this software
     in a product, an acknowledgment in the product documentation would be
     appreciated but is not required.
  2. Altered source versions must be plainly marked as such, and must not be
     misrepresented as being the original software.
  3. This notice may not be removed or altered from any source distribution.
*/
#include "SDL_internal.h"

#include <stdio.h>
#include <string.h>
#include <stdlib.h>

#include "../SDL/src/audio/SDL_audiodev_c.h"
#include "../SDL/src/audio/SDL_sysaudio.h"
#include "bsp/esp-bsp.h"
#include "SDL_espaudio.h"
#include "esp_log.h"
#include "esp_attr.h"
#include "driver/i2s_std.h"

static i2s_chan_handle_t tx_chan;
static i2s_chan_handle_t rx_chan;        // I2S rx channel handler

static bool audioEnabled = false;

#define SAMPLECOUNT       16
#define SAMPLERATE        11025 * 4 // Hz
#define SAMPLESIZE        2       // 16bit

static bool ESPAUDIO_OpenDevice(SDL_AudioDevice *device)
{
    ESP_LOGI("SDL", "ESP Audio Initilializing...");
    device->hidden = (struct SDL_PrivateAudioData *) SDL_calloc(1, sizeof(*device->hidden));
    if (!device->hidden) {
        return false;
    }

    // device only natively supports S16LSB
    device->spec.format = SDL_AUDIO_S16LE;

    /*  PSP has some limitations with the Audio. It fully supports 44.1KHz (Mono & Stereo),
        however with frequencies different than 44.1KHz, it just supports Stereo,
        so a resampler must be done for these scenarios */
    
    // The number of samples to output in one output call (min 17, max 4111).
    device->sample_frames = SAMPLECOUNT;
    device->buffer_size = device->sample_frames * SAMPLESIZE * ((device->spec.channels == 1) ? 1 : 2);
    device->spec.channels = device->spec.channels == 1 ? 1 : 2;

    device->hidden->rawbuf = heap_caps_malloc(device->buffer_size, MALLOC_CAP_8BIT | MALLOC_CAP_DMA);
    if (!device->hidden->rawbuf) {
        return SDL_SetError("Couldn't allocate mixing buffer");
    }

    SDL_memset(device->hidden->rawbuf, device->silence_value, device->buffer_size);

    // Update the fragment size as size in bytes.
    SDL_UpdatedAudioDeviceFormat(device);

    /* Allocate the mixing buffer.  Its size and starting address must
       be a multiple of 64 bytes.  Our sample count is already a multiple of
       64, so spec->size should be a multiple of 64 as well. */

    /* Setp 1: Determine the I2S channel configuration and allocate both channels
     * The default configuration can be generated by the helper macro,
     * it only requires the I2S controller id and I2S role */
    i2s_chan_config_t chan_cfg = I2S_CHANNEL_DEFAULT_CONFIG(I2S_NUM_AUTO, I2S_ROLE_MASTER);
    ESP_ERROR_CHECK(i2s_new_channel(&chan_cfg, &tx_chan, &rx_chan));

    /* Step 2: Setting the configurations of standard mode, and initialize rx & tx channels
     * The slot configuration and clock configuration can be generated by the macros
     * These two helper macros is defined in 'i2s_std.h' which can only be used in STD mode.
     * They can help to specify the slot and clock configurations for initialization or re-configuring */
    i2s_std_config_t std_cfg = {
        .clk_cfg  = I2S_STD_CLK_DEFAULT_CONFIG(device->spec.freq),
        .slot_cfg = I2S_STD_MSB_SLOT_DEFAULT_CONFIG(I2S_DATA_BIT_WIDTH_16BIT, device->spec.channels == 1 ? I2S_SLOT_MODE_MONO : I2S_SLOT_MODE_STEREO),
        .gpio_cfg = {
            .mclk = I2S_GPIO_UNUSED,    // some codecs may require mclk signal, this example doesn't need it
            .bclk = CONFIG_BSP_I2S_SCLK,
            .ws   = CONFIG_BSP_I2S_LCLK,
            .dout = CONFIG_BSP_I2S_DOUT,
            .din  = CONFIG_BSP_I2S_DSIN, // In duplex mode, bind output and input to a same gpio can loopback internally
            .invert_flags = {
                .mclk_inv = false,
                .bclk_inv = false,
                .ws_inv   = false,
            },
        },
    };
    /* Initialize the channels */
    ESP_ERROR_CHECK(i2s_channel_init_std_mode(tx_chan, &std_cfg));
    ESP_ERROR_CHECK(i2s_channel_init_std_mode(rx_chan, &std_cfg));

    audioEnabled = true;

    ESP_LOGI("SDL", "ESP Audio Initialized");

    return true;
}

static bool ESPAUDIO_PlayDevice(SDL_AudioDevice *device, const Uint8 *buffer, int buflen)
{
    size_t w_bytes = buflen;

    if (audioEnabled == true)
    {
        /* Enable the TX channel */
        ESP_ERROR_CHECK(i2s_channel_enable(tx_chan));

        /* Write i2s data */
        if (i2s_channel_write(tx_chan, buffer, buflen, &w_bytes, 1000) != ESP_OK) {
            ESP_LOGI("SDL", "Write Task: i2s write failed\n");
            return false;
        } else {
#ifdef VERBOSE
            ESP_LOGI("SDL", "Write Task: i2s write of %lu bytes done\n", w_bytes);
#endif
            vTaskDelay(pdMS_TO_TICKS(200));
        }

        /* Enable the TX channel */
        ESP_ERROR_CHECK(i2s_channel_disable(tx_chan));

        return true;
    }

    return false;
}

static bool ESPAUDIO_WaitDevice(SDL_AudioDevice *device)
{
    return true;  // Because we block when sending audio, there's no need for this function to do anything.
}

static Uint8 *ESPAUDIO_GetDeviceBuf(SDL_AudioDevice *device, int *buffer_size)
{
    Uint8 *buffer = device->hidden->rawbuf;

    if (buffer_size != NULL)
    {
        buffer_size[0] = device->buffer_size;
    }

    return buffer;
}

static void ESPAUDIO_CloseDevice(SDL_AudioDevice *device)
{
    if (device->hidden) {
        if (device->hidden->rawbuf) {
            SDL_aligned_free(device->hidden->rawbuf);
            device->hidden->rawbuf = NULL;
        }
    }
}

static void ESPAUDIO_ThreadInit(SDL_AudioDevice *device)
{
}

static bool ESPAUDIO_Init(SDL_AudioDriverImpl *impl)
{
    impl->OpenDevice = ESPAUDIO_OpenDevice;
    impl->PlayDevice = ESPAUDIO_PlayDevice;
    impl->WaitDevice = ESPAUDIO_WaitDevice;
    impl->GetDeviceBuf = ESPAUDIO_GetDeviceBuf;
    impl->CloseDevice = ESPAUDIO_CloseDevice;
    impl->ThreadInit = ESPAUDIO_ThreadInit;
    impl->OnlyHasDefaultPlaybackDevice = true;
    //impl->HasRecordingSupport = true;
    //impl->OnlyHasDefaultRecordingDevice = true;
    return true;
}

AudioBootStrap PRIVATEAUDIO_bootstrap = {
    "esp", "ESP audio driver", ESPAUDIO_Init, false, false
};
