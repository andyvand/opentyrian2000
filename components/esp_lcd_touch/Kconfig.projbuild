## components/esp_lcd_touch/Kconfig.projbuild
```kconfig
menu "ESP LCD TOUCH"

    config ESP_LCD_TOUCH_MAX_POINTS
        int "Maximum count of the touch points"
        depends on TOUCH_ENABLED
        range 1 10
        default 5

    config ESP_LCD_TOUCH_MAX_BUTTONS
        int "Maximum count of the touch buttons supported"
        depends on TOUCH_ENABLED
        range 0 10
        default 1

endmenu
```

## main/Kconfig.projbuild
```kconfig
menu "WiFi Configuration"

    config NETWORK_GAME 
        bool "Network game"
        default n
        help
            Configure to start a network game.

    config IP_ADDRESS
        string "Opponent IP address"
	depends on NETWORK_GAME
        default "192.168.1.100"
        help
            Network opponent IP address.

    config PLAYER_NUMBER
        string "Player number"
	depends on NETWORK_GAME
        default "1"
        help
            Player number (1 or 2).

    config PLAYER_NAME
        string "Player name"
	depends on NETWORK_GAME
        default "Player"
        help
            Player name.

    config WIFI_SSID
        string "WiFi SSID"
	depends on NETWORK_GAME
        default "network_ssid"
        help
            SSID (network name) for OpenTyrian2000 to connect to.

    config WIFI_PASSWORD
        string "WiFi Password"
	depends on NETWORK_GAME
        default ""
        help
            WiFi password (WPA or WPA2) for OpenTyrian2000 to use.

    choice SCAN_METHOD
        prompt "scan method"
	depends on NETWORK_GAME
        default WIFI_FAST_SCAN
        help
            scan method for the esp32 to use

        config WIFI_FAST_SCAN
            bool "fast"
        config WIFI_ALL_CHANNEL_SCAN
            bool "all"
    endchoice

    choice SORT_METHOD
        prompt "sort method"
	depends on NETWORK_GAME
        default WIFI_CONNECT_AP_BY_SIGNAL
        help
            sort method for the esp32 to use

        config WIFI_CONNECT_AP_BY_SIGNAL
            bool "rssi"
        config WIFI_CONNECT_AP_BY_SECURITY
            bool "authmode"
    endchoice

    config FAST_SCAN_THRESHOLD
        bool "fast scan threshold"
	depends on NETWORK_GAME
        default y
        help
            wifi fast scan threshold

    config FAST_SCAN_MINIMUM_SIGNAL
        int "fast scan minimum rssi"
        depends on FAST_SCAN_THRESHOLD
        range -127 0
        default -127
        help
            rssi is use to measure the signal
 
    choice FAST_SCAN_WEAKEST_AUTHMODE
        prompt "fast scan weakest authmode"
        depends on FAST_SCAN_THRESHOLD
        default EXAMPLE_OPEN

        config EXAMPLE_OPEN
            bool "open"
        config EXAMPLE_WEP
            bool "wep"
        config EXAMPLE_WPA
            bool "wpa"
        config EXAMPLE_WPA2
            bool "wpa2"
    endchoice

endmenu
```
